## kernel/drivers/net/wireless/rkusbwifi/rtl8723as/Kconfig
```kconfig
config RTL8723AS
	tristate "Realtek 8723AS USB WiFi Support"
	depends on USB
	select WIRELESS_EXT
	select WEXT_PRIV
	select IEEE80211
	---help---
	  Help message of RTL8723AS
```
